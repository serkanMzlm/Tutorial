## menuconfig/Kconfig
```kconfig
# Her şeyi kapsayan başlıktır.
mainmenu "Menu Config Tutorial"

# Sadece ekranda bilgi oluşturmak için kullanılır.
comment "Used for Information" 

# Yeni bir "src" adında menü bloğu oluşturur. Bazı durumlarda boşluklar
# yüzünden 'endmenu' in different file than 'menu' hatası verebilir.
menu "src"
# `choice` Seçenek grubu. 
# `prompt` seçim grubunun adıdır.
# `default` ön tanımlı değer. 
# `PLATFORM_NUTTX` değişken adı
# `config` değişken oluşturur. Hemen altında türünü belirtiriz.
# Değişken türünün yanında da kutuda gözükücek yazı olur.
# Değişken türleri `tristate, bool, string, hex, int`
    choice 
        prompt "Platform"
        default PLATFORM_NUTTX
        config PLATFORM_NUTTX
            bool "nuttx"
        config PLATFORM_POSIX
            bool "posix"
    endchoice

# `help` kısmı bilgi olarak gözükücek yazıyı ayarlar.
    config NAME
        default "serkan"
        string "name"
        help
            your name

# `range` girilen sayı aralığının sınırlanmasını sağlar.
    config AGE
        default 0
        range 0 10
        int "age"
        help
            your age

# `if` koşullama yapılıp default değer düzenlenir
    config BOARD_PLATFORM
        string "board platform"
        default "nuttx" if PLATFORM_NUTTX
        default "posix" if PLATFORM_POSIX

    config USE_CLOCK_PLL
            bool "use clock ppl"
            default 20
            range 8 86
# `if` sayesinde PPL değişkeninin görünürlüğü ayarlanır.
# USE_CLOCK_PLL seçilmesi durumunda görünür olur.
    config CLOCK_PLL_N
            int "PPL" if USE_CLOCK_PLL
            default 20
            range 8 86
endmenu

# `PLATFORM_QURT || PLATFORM_POSIX` ikisinden biri true ise görünür
# olur. `source` belirli kaynakta bulunan konfig dosyasını çalıştırır.
menu "drivers"
	depends on MODULE_PERIPH_COMMON || PLATFORM_POSIX
	source "drivers/Kconfig"
endmenu

config MODULE_PERIPH_ADC
	 bool "ADC peripheral driver"
	 depends on PLATFORM_NUTTX
	 select MODULE_PERIPH_COMMON

# VAL_2 secilmesi durumunda yeni seçim pencereleri görünür olur
choice
    tristate "Top Level Choice"
    config VAL_1
        tristate "Value 1"
    config VAL_2
        tristate "Value 2"
    
    if VAL_2
        choice
            tristate "Nested Choice"
            config SUB_VAL_1
                tristate "Nested Value 1"
            config SUB_VAL_2
                tristate "Nested Value 2"
        endchoice
    endif
endchoice 
```
